## dts/bindings/zmk,input-processor-3stage.yaml
```yaml
# Copyright (c) 2025 soranomutech
# SPDX-License-Identifier: MIT

description: |
  Pointing acceleration input processor (up to 5 zones).
  Zone A (0 to speed-flat-low): flat at min-factor (optional low flat zone).
  Zone B (speed-flat-low to speed-low): factor ramps from min-factor to mid-factor.
  Zone C (speed-low to speed-high): flat at mid-factor.
  Zone D (speed-high to speed-max): factor ramps from mid-factor to max-factor.
  Zone E (above speed-max): flat at max-factor.
  If speed-flat-low is 0 (default), Zone A is disabled and behavior matches
  the original 3-zone (decel / flat / accel) curve.

compatible: "zmk,input-processor-3stage"

include: ip_zero_param.yaml

properties:
  input-type:
    type: int
    required: true
    description: Input event type (e.g. INPUT_EV_REL)

  min-factor:
    type: int
    required: true
    description: |
      Factor at speed=0 (scaled x1000). E.g. 560 = 0.56x.
      Used for precision at very slow trackball movements.

  mid-factor:
    type: int
    required: true
    description: |
      Factor in the flat zone (scaled x1000). E.g. 1000 = 1.0x.
      This is the "normal" speed factor.

  max-factor:
    type: int
    required: true
    description: |
      Factor at speed-max (scaled x1000). E.g. 3000 = 3.0x.
      Maximum acceleration for fast movements.

  speed-flat-low:
    type: int
    default: 0
    description: |
      End of the low flat zone (counts per second).
      Below this speed, factor stays constant at min-factor.
      Set to 0 (default) to disable the low flat zone and keep 3-zone behavior.

  speed-low:
    type: int
    required: true
    description: |
      End of deceleration zone (counts per second).
      Between speed-flat-low and this, factor interpolates from min-factor to mid-factor.
      Set to 0 to disable deceleration zone.

  speed-high:
    type: int
    required: true
    description: |
      Start of acceleration zone (counts per second).
      Between speed-low and speed-high, factor stays at mid-factor.
      Above this speed, factor interpolates from mid-factor to max-factor.

  speed-max:
    type: int
    required: true
    description: |
      Speed at which max-factor is reached (counts per second).
      Movements faster than this use max-factor.

  deceleration-exponent:
    type: int
    default: 1
    description: |
      Curve shape for deceleration zone. 1=linear, 2=quadratic, etc.

  acceleration-exponent:
    type: int
    default: 2
    description: |
      Curve shape for acceleration zone. 1=linear, 2=quadratic, etc.
```

## src/Kconfig
```kconfig
DT_COMPAT_ZMK_INPUT_PROCESSOR_3STAGE := zmk,input-processor-3stage

config ZMK_INPUT_PROCESSOR_3STAGE
    bool "Enable 3-stage pointing acceleration"
    default $(dt_compat_enabled,$(DT_COMPAT_ZMK_INPUT_PROCESSOR_3STAGE))
    depends on ZMK_POINTING
    depends on INPUT
    help
      Enables 3-stage velocity-based acceleration for relative pointer input.
      Stage 1: deceleration (slow speed → precision)
      Stage 2: flat zone (normal speed → 1:1)
      Stage 3: acceleration (fast speed → amplified)
```
